## workshop-ai/assignments/part-1/001-ai-project-setup/final/esp32s3-eye/sdkconfig.defaults
```kconfig
CONFIG_IDF_TARGET="esp32s3"
CONFIG_BSP_SELECT_ESP32_S3_EYE=y
CONFIG_ESPTOOLPY_FLASHSIZE_4MB=y
CONFIG_ESP_DEFAULT_CPU_FREQ_MHZ_240=y
CONFIG_ESPTOOLPY_FLASHFREQ_80M=y
CONFIG_ESPTOOLPY_FLASHMODE_QIO=y

# Enable PSRAM (embedded 8MB on ESP32-S3-EYE module)
CONFIG_SPIRAM=y
CONFIG_SPIRAM_MODE_OCT=y
CONFIG_SPIRAM_SPEED_80M=y
CONFIG_SPIRAM_USE_CAPS_ALLOC=y

# FreeRTOS
CONFIG_FREERTOS_HZ=1000

# Camera config
CONFIG_CAMERA_XCLK_USE_LEDC=y
CONFIG_EXAMPLE_ENABLE_DVP_CAM_SENSOR=y
CONFIG_CAMERA_OV2640=y
CONFIG_CAMERA_OV2640_DVP_RGB565_240X240_25FPS=y
CONFIG_CAM_CTRL_SPI_ENABLE=n

# LVGL
CONFIG_LV_CONF_SKIP=y
CONFIG_LV_USE_CLIB_MALLOC=y
```
